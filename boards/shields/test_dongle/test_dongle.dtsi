#include "test_dongle-layouts.dtsi"
#include <dt-bindings/zmk/matrix_transform.h>

/ {
    matrix_transform0: matrix_transform0 {
        compatible = "zmk,matrix-transform";
        columns = <2>;
        rows = <1>;
        map = <
            RC(0,0) RC(0,1)
        >;
    };
};

&physical_layout_test_dongle {
    transform = <&matrix_transform0>;
};

