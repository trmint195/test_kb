#include "test_dongle.dtsi"

/ {
    kscan0: kscan0 {
        compatible = "zmk,kscan-gpio-direct";
        wakeup-source;

        input-gpios
            = <&pro_micro 10 (GPIO_ACTIVE_LOW | GPIO_PULL_UP)>
            , <&pro_micro 9 (GPIO_ACTIVE_LOW | GPIO_PULL_UP)>
            ;
    };
};

&physical_layout_test_dongle {
    kscan = <&kscan0>;
};

